## Software/nrf_desktop-2026-2-5/drivers/sensor/pmw3389/Kconfig
```kconfig
#
# Copyright (c) 2026 Christian
# SPDX-License-Identifier: MIT
#
# PMW3389 optical mouse sensor driver Kconfig

config PMW3389
	bool "PMW3389 optical mouse sensor driver"
	default n
	select SPI
	select GPIO
	depends on DT_HAS_PIXART_PMW3389_ENABLED
	help
	  Enable driver for the PixArt PMW3389 optical mouse sensor.
	  Implements the Zephyr Sensor API (trigger + sample_fetch +
	  channel_get + attr_set) so it is compatible with the nRF
	  Desktop motion_sensor module.

config PMW3389_LOG_LEVEL
	int "PMW3389 log level"
	depends on PMW3389
	default 3
	range 0 4
	help
	  Log verbosity for the PMW3389 driver.
	  0 = none, 1 = error, 2 = warn, 3 = info, 4 = debug.
```

## Software/nrf_desktop-2026-2-5/dts/bindings/sensor/pixart,pmw3389.yaml
```yaml
# Copyright (c) 2026 Christian
# SPDX-License-Identifier: MIT

description: |
  PMW3389 optical mouse sensor from PixArt Imaging.
  High-performance gaming sensor with SPI interface,
  configurable CPI (50–16000), and optional motion interrupt.

compatible: "pixart,pmw3389"

include: spi-device.yaml

properties:
  irq-gpios:
    type: phandle-array
    required: true
    description: |
      GPIO connected to the sensor MOTION pin. The sensor drives
      this pin active-low when new motion data is available.
      Configure with GPIO_ACTIVE_LOW and optionally GPIO_PULL_UP.

  reset-gpios:
    type: phandle-array
    required: false
    description: |
      GPIO connected to the sensor NRESET pin (active-low hardware reset).
      When specified, the driver drives this pin HIGH (inactive) during init
      to ensure the sensor is released from reset before SPI communication.
      Use GPIO_ACTIVE_LOW so that GPIO_OUTPUT_INACTIVE = pin HIGH.
      If omitted the sensor relies on an external pull-up on NRESET.
```

## Software/nrf_desktop_5/west.yml
```yaml
manifest:
  remotes:
    - name: zmkfirmware
      url-base: https://github.com/zmkfirmware
    - name: teamspatzenhirn
      url-base: https://github.com/teamspatzenhirn
  projects:
    - name: pmw3389_zephyr_driver
      remote: teamspatzenhirn
      revision: main
      path: modules/drivers/pmw3389
```

## Software/old/broadcaster/build/Kconfig/boards/Kconfig.defconfig
```kconfig
# Load Zephyr board defconfig descriptions.
osource "C:/ncs/v3.1.1/nrf/boards/nordic/nrf52840gmouse/Kconfig.defconfig"
```

## Software/old/broadcaster/build/broadcaster/Kconfig/boards/Kconfig
```kconfig
# Load Zephyr board Kconfig descriptions.
osource "C:/ncs/v3.1.1/nrf/boards/nordic/nrf52840gmouse/Kconfig"
```
